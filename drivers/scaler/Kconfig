## drivers/scaler/Kconfig
```kconfig
# Copyright (c) 2026 Jilay Sandeep Pandya
# SPDX-License-Identifier: Apache-2.0

menuconfig SCALER
	bool "Scaler device drivers"
	help
	  This option enables the scaler custom driver class.

if SCALER

config SCALER_INIT_PRIORITY
	int "Scaler device drivers init priority"
	default KERNEL_INIT_PRIORITY_DEVICE
	help
	  Scaler device drivers init priority.

module = SCALER
module-str = scaler
source "subsys/logging/Kconfig.template.log_config"

rsource "Kconfig.zephyr_scaler"

endif # SCALER
```

## drivers/scaler/Kconfig.zephyr_scaler
```kconfig
# Copyright (c) 2024 Jilay Sandeep Pandya
# SPDX-License-Identifier: Apache-2.0

config ZEPHYR_SCALER
	bool "Zephyr Scaler Driver"
	default y
	depends on DT_HAS_ZEPHYR_SCALER_ENABLED
```

## dts/bindings/scaler/zephyr,scaler.yaml
```yaml
# Copyright (c) 2024 Jilay Sandeep Pandya
# SPDX-License-Identifier: Apache-2.0

description: |
  An example scaler 

compatible: "zephyr,scaler"

include: base.yaml

properties:
  scaling-factor:
    type: int
    required: true
```

## lib/stepper_control/Kconfig
```kconfig
config STEPPER_CONTROL
    bool "Support for stepper_control library"
    help
      This option enables the 'stepper_control' library
```

## subsys/Kconfig
```kconfig
# SPDX-FileCopyrightText: Copyright (c) 2026 Jilay Sandeep Pandya
# SPDX-License-Identifier: Apache-2.0

rsource "can_uart_replay/Kconfig"
```

## subsys/can_uart_replay/Kconfig
```kconfig
# SPDX-FileCopyrightText: Copyright (c) 2026 Jilay Sandeep Pandya
# SPDX-License-Identifier: Apache-2.0

config CAN_UART_REPLAY
	bool "CAN UART replay subsystem"
	select CAN
	select UART
	help
	  Enable the CAN UART replay subsystem. This subsystem allows replaying CAN frames received over UART. It is designed to facilitate testing and debugging of CAN applications by providing a means to replay captured CAN traffic.

if CAN_UART_REPLAY

config CAN_UART_REPLAY_THREAD_STACK_SIZE
	int "CAN RX thread stack size"
	default 1024
	help
	  Stack size for the CAN RX listener thread.

config CAN_UART_REPLAY_THREAD_PRIORITY
	int "CAN RX thread priority"
	default 5
	help
	  Cooperative or preemptive priority for the CAN RX listener thread.

# ---------------------------------------------------------------------------
# Optional start / stop trigger IDs
# ---------------------------------------------------------------------------

config CAN_UART_REPLAY_START_ID
	hex "RX start-trigger CAN ID"
	default 0xFFFF
	range 0x000 0xFFFF
	help
	  11-bit standard CAN ID that triggers the start of frame printing.
	  Default value 0xFFFF means no start trigger: printing begins immediately
	  at boot.

config CAN_UART_REPLAY_STOP_ID
	hex "RX stop-trigger CAN ID"
	default 0xFFFF
	range 0x000 0xFFFF
	help
	  11-bit standard CAN ID that halts frame printing permanently.
	  Default value 0xFFFF means no stop trigger: printing continues
	  indefinitely unless the system is halted.

config CAN_UART_REPLAY_HELLO_SPECIALIZED_ID
	hex "RX hello-specialized CAN ID"
	default 0xFFFF
	range 0x000 0xFFFF
	help
	  11-bit standard CAN ID that, when received, prints "hello specialized"
	  to UART and log. Default value 0xFFFF means this trigger is disabled.

# ---------------------------------------------------------------------------
# RX filter
# ---------------------------------------------------------------------------

config CAN_UART_REPLAY_FILTER_ID
	hex "RX filter CAN ID"
	default 0x000
	range 0x000 0x7FF
	help
	  11-bit standard CAN ID used in the hardware RX filter.  A frame is
	  accepted when (frame.id & CAN_UART_REPLAY_FILTER_MASK) ==
	  (CAN_UART_REPLAY_FILTER_ID & CAN_UART_REPLAY_FILTER_MASK).
	  The default value 0x000 combined with mask 0x000 accepts every frame.

config CAN_UART_REPLAY_FILTER_MASK
	hex "RX filter ID mask (0x000 = accept all)"
	default 0x000
	range 0x000 0x7FF
	help
	  Bits set to 1 are checked against CAN_UART_REPLAY_FILTER_ID.
	  0x000 — accept all standard frames (no bits checked).
	  0x7FF — exact match on the full 11-bit ID.
	  Power-of-two-aligned ranges are also possible, e.g. 0x700 accepts
	  IDs 0x100–0x1FF when filter ID is 0x100.

rsource "Kconfig.can_random_traffic"

module = CAN_UART_REPLAY
module-str = can_uart_replay
source "subsys/logging/Kconfig.template.log_config"

endif # CAN_UART_REPLAY
```

## subsys/can_uart_replay/Kconfig.can_random_traffic
```kconfig
# SPDX-FileCopyrightText: Copyright (c) 2026 Jilay Sandeep Pandya
# SPDX-License-Identifier: Apache-2.0

config CAN_RANDOM_TRAFFIC
	bool "Generate random CAN traffic"
	select ENTROPY_GENERATOR
	help
	  When enabled, the subsystem transmits randomly generated CAN frames
	  at random intervals to exercise the bus.

# ---------------------------------------------------------------------------
# Periodic TX schedule (fixed slots, up to 3)
# ---------------------------------------------------------------------------

if CAN_RANDOM_TRAFFIC

config CAN_RAND_TX_MSG_COUNT
	int "Number of periodic CAN TX messages"
	default 0
	range 0 3
	help
	  How many periodic TX schedule entries are active (0 disables TX).
	  Configure each active slot below (MSG0 … MSG2).

# --- Slot 0 ---
if CAN_RAND_TX_MSG_COUNT >= 1
module = CAN_RAND_TX_MSG0
module-str = "CAN TX message 0"
rsource "Kconfig.template.can_tx_schedule"
endif

# --- Slot 1 ---
if CAN_RAND_TX_MSG_COUNT >= 2
module = CAN_RAND_TX_MSG1
module-str = "CAN TX message 1"
rsource "Kconfig.template.can_tx_schedule"
endif

# --- Slot 2 ---
if CAN_RAND_TX_MSG_COUNT >= 3
module = CAN_RAND_TX_MSG2
module-str = "CAN TX message 2"
rsource "Kconfig.template.can_tx_schedule"
endif

endif # CAN_RANDOM_TRAFFIC
```

## tests/subsys/can_uart_replay/testcase.yaml
```yaml
# SPDX-FileCopyrightText: Copyright (c) 2026 Jilay Sandeep Pandya
# SPDX-License-Identifier: Apache-2.0

tests:
  # -----------------------------------------------------------------------
  # Default scenario: no start/stop triggers, printing begins immediately
  # and continues indefinitely.
  # Runs suite: can_uart_replay
  # -----------------------------------------------------------------------
  can_uart_replay.default:
    tags: can uart
    platform_allow:
      - qemu_cortex_m3

  # -----------------------------------------------------------------------
  # Start/stop trigger scenario: printing is gated by a start-trigger CAN
  # ID (0x100) and halted by a stop-trigger CAN ID (0x200).
  # Runs suite: can_uart_replay_triggers
  # -----------------------------------------------------------------------
  can_uart_replay.start_stop:
    tags: can uart
    extra_configs:
      - CONFIG_CAN_UART_REPLAY_START_ID=0x100
      - CONFIG_CAN_UART_REPLAY_STOP_ID=0x200
      - CONFIG_CAN_UART_REPLAY_FILTER_ID=0x100
      - CONFIG_CAN_UART_REPLAY_FILTER_MASK=0x700
    platform_allow:
      - qemu_cortex_m3


  # -----------------------------------------------------------------------
  # Hello-specialized scenario: receiving a specific CAN ID (0x300) causes
  # the subsystem to print "hello specialized" on UART.
  # Runs suite: can_uart_replay_hello
  # -----------------------------------------------------------------------
  can_uart_replay.hello_specialized:
    tags: can uart
    extra_configs:
      - CONFIG_CAN_UART_REPLAY_HELLO_SPECIALIZED_ID=0x300
    platform_allow:
      - qemu_cortex_m3
```
