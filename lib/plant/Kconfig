## lib/plant/Kconfig
```kconfig
config PLANT
    bool "Plant"

choice
    prompt "Plant model type"
    default PHYSICAL_PLANT_MODEL

config PHYSICAL_PLANT_MODEL
    bool "Physical plant model"
    depends on BROKEN

config STATE_SPACE_MODEL
    bool "State-space plant model"

endchoice

choice
    prompt "Plant model"
    default PLANT_MODEL_DC_MOTOR

config PLANT_MODEL_DC_MOTOR
    bool "DC Motor"

endchoice
```

## subsys/motion_control/Kconfig
```kconfig
# SPDX-FileCopyrightText: Copyright (c) 2026 Jilay Sandeep Pandya
# SPDX-License-Identifier: Apache-2.0

config MOTION_CONTROL
    bool "Motion Control Subsystem"

if MOTION_CONTROL

config MOTION_CONTROL_SERVICES
    bool "Motion Control Services"
    select MOTION_CONTROL_SERVICES_REGISTER
    select MOTION_CONTROL_EVENT_HANDLER
    select JSON_LIBRARY

config MOTION_CONTROL_EVENT_HANDLER
    bool "Motion Control Event Handler"

config MOTION_CONTROL_SERVICES_REGISTER
    bool "Motion Control Services Register"
    depends on MQTT_PUB_SUB_CLIENT

endif # MOTION_CONTROL
```
