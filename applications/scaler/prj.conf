## prj.conf
```kconfig
CONFIG_SCALER=y
```

## boards/qemu_x86_64.overlay
```dts
/*
 * SPDX-FileCopyrightText: Copyright (c) 2024 Jilay Sandeep Pandya
 * SPDX-License-Identifier: Apache-2.0
 */

/ {
	scaler: zephyr_scaler {
		compatible = "zephyr,scaler";
		status = "okay";
        scaling-factor = <1>;
	};
};
```

## src/main.c
```c
#include <app/drivers/scaler.h>

int main(void)
{
    const struct device *scaler_dev = DEVICE_DT_GET(DT_NODELABEL(scaler));
    scaler_set(scaler_dev, 0x01, 0xFF);
    return 0;
}
```
